#include <SPI.h>
#include <Wire.h>
#include <Adafruit_GFX.h>
#include <Adafruit_ILI9341.h>
#include <math.h>
#include <WiFi.h>              // [WIFI ADDED]
#include <WiFiClientSecure.h>    // [WIFI ADDED]
#include <HTTPClient.h>          // [WIFI ADDED]
#include <esp_system.h>          // [LCD FIX] reset-reason report
#include <Preferences.h>         // [LINK ADDED] stores the device's secret ID
#include "soilsense_tinyml.h"    // [TINYML ADDED] on-device crop model (keep this file next to the .ino)

// ============================================================
// AGRI SENSE / SOILSENSE
// ESP32-S3 + ILI9341 + FT6336 + RS485 7-IN-1 SOIL SENSOR
//
// DISPLAY:
// Landscape 320 x 240
//
// TFT:
// CS   = GPIO 10
// RST  = GPIO 9
// DC   = GPIO 8
// MOSI = GPIO 11
// SCK  = GPIO 12
// MISO = GPIO 13
// LED  = GPIO 7
//
// TOUCH:
// SDA  = GPIO 3
// SCL  = GPIO 6
// RST  = GPIO 5
// INT  = GPIO 2
//
// RS485:
// RX = GPIO 16
// TX = GPIO 17
// DE/RE = GPIO 4
// ============================================================


// ============================================================
// PRESET DATA = SAME AS THE WEBSITE
//  * crops + TinyML networks : soilsense_tinyml.h (22 Philippine crops,
//    generated by tinyml/train_tinyml.py on the website project).
//    Keep that file in the SAME folder as this .ino.
//  * soil thresholds         : N/P 40-120 (watch 25-130), K 40-120
//    (watch 25-150), pH 6.0-7.0 (watch 5.5-7.5), moisture 50-90
//    (watch 40-95), temperature 20-35 (watch 15-40)
//  * soil health score       : 6 checks (N, P, K, pH, temp, moisture),
//    grade A 85+, B 65+, C 45+, D below   (no rainfall)
//  * crop tier               : Excellent 85%+, Good 60%+, else Fair
// ============================================================


// ============================================================
// HOW IT WORKS NOW
//  1. On power-up the LCD connects to Wi-Fi and shows a
//     6-character code. Nothing else runs until a website user
//     links the device (website > "Link Device").
//  2. After linking, the main screens appear. The sensor is read
//     ONLY when you press the "Scan now" button (top bar); the
//     reading is then sent to the website, into the account that
//     linked the device. No username is stored in this code.
//  3. To hand the device to someone else: hold your finger on the
//     "SoilSense" logo (top-left) for 1.5 s, or press "Unlink" on
//     the website. The LCD goes back to the code screen.
// ============================================================


// ============================================================
// RS485 / NPK SENSOR
// ============================================================

#define RX2_PIN    16
#define TX2_PIN    17
#define RE_DE_PIN  4


// ============================================================
// TFT
// ============================================================

#define TFT_CS     10
#define TFT_RST    9
#define TFT_DC     8
#define TFT_MOSI   1
#define TFT_SCK    2
#define TFT_MISO   21
#define TFT_LED    7


// ============================================================
// FT6336 TOUCH
// ============================================================

#define CTP_SDA    38
#define CTP_SCL    39
#define CTP_RST    9
#define CTP_INT    2

#define FT6336_ADDR 0x38


// ============================================================
// TFT OBJECT
// ============================================================

Adafruit_ILI9341 tft(
  TFT_CS,
  TFT_DC,
  TFT_RST
);


// ============================================================
// [LCD FIX] SETTINGS FOR A STABLE SCREEN
// ------------------------------------------------------------
// The black / glitching screen appears when the Wi-Fi radio
// draws current in short bursts: the supply dips or the SPI
// wires pick up noise, the LCD controller resets itself and
// forgets its settings. Three protections are added:
//   1. slower SPI clock       (more noise margin on jumper wires)
//   2. lower Wi-Fi TX power   (smaller current bursts)
//   3. LCD watchdog           (detects a reset panel and re-initialises it)
// ============================================================

// Library default is 32 MHz. 10 MHz is plenty for this UI.
// If the screen is rock-solid you may try 16000000 again.
const uint32_t TFT_SPI_HZ = 10000000;

// Lower = smaller current bursts. 11 dBm is fine inside a room.
// Raise to WIFI_POWER_15dBm only if Wi-Fi does not connect.
const wifi_power_t WIFI_TX_POWER = WIFI_POWER_11dBm;

void applyWifiTxPower() {

  WiFi.setTxPower(WIFI_TX_POWER);
}


// ============================================================
// NPK MODBUS REQUEST
// ============================================================

const byte query[] = {
  0x01,
  0x03,
  0x00,
  0x00,
  0x00,
  0x07,
  0x04,
  0x08
};

byte response[32];


// ============================================================
// SENSOR VALUES
// ============================================================

float soilHumidity = 0.0;
float soilTemperature = 0.0;
float soilPH = 0.0;

uint16_t soilConductivity = 0;

uint16_t nitrogen = 0;
uint16_t phosphorus = 0;
uint16_t potassium = 0;

bool sensorOK = false;


// ============================================================
// SCREEN
// ============================================================

// 0 = DASHBOARD
// 1 = SOIL
// 2 = NPK

int currentScreen = 0;


// ============================================================
// TIMER
// ============================================================

unsigned long lastSensorRead = 0;

const unsigned long SENSOR_INTERVAL = 3000;


// ============================================================
// TOUCH
// ============================================================

int touchX = 0;
int touchY = 0;

bool previousTouch = false;

unsigned long touchStartMs = 0;      // [LINK ADDED] for the long-press on the logo
bool longPressDone = false;


// ============================================================
// [SCAN / LINK ADDED] APP STATE
// ============================================================

// App state: LINKING = waiting for a website user to link the device
//            READY   = linked, main screens + Scan now button active
#define APP_LINKING 0
#define APP_READY   1

int appState = APP_LINKING;

// "Scan now" button states (drawn in the top bar)
#define BTN_IDLE      0
#define BTN_SCANNING  1
#define BTN_SENDING   2
#define BTN_SENT      3
#define BTN_FAILED    4
#define BTN_NO_SENSOR 5
#define BTN_NO_WIFI   6
#define BTN_SAVED     7     // [OFFLINE ADDED] scan stored on the ESP32-S3, waiting for Wi-Fi
#define BTN_SYNCING   8     // [OFFLINE ADDED] uploading stored scans

int scanBtnState = BTN_IDLE;
unsigned long scanBtnResetAt = 0;

bool hasScanned = false;             // true after the first Scan now of a session

// Defined near the bottom of the file
void doScan();
void switchUser();
void goPairing();
void offlineSyncTick();     // [OFFLINE ADDED]
int  offlineCountPending(); // [OFFLINE ADDED]
void forgetOwner();         // [OFFLINE ADDED]
void showMessage(const String &l1, const String &l2, const String &l3);  // [OFFLINE ADDED]


// ============================================================
// SOILSENSE COLOR PALETTE
// ============================================================

#define COL_BG          0x0040
#define COL_BG_RAISED   0x0881
#define COL_PANEL       0x10C2
#define COL_PANEL_HI    0x1103
#define COL_BORDER      0x2A05
#define COL_BORDER_LO   0x1923

#define COL_ACCENT      0x7FCD
#define COL_ACCENT_DIM  0x19A3

#define COL_TEXT        0xEFBD
#define COL_MUTED       0x8D12
#define COL_FAINT       0x5B6C

#define COL_AMBER       0xED49
#define COL_RED         0xEB4B
#define COL_BLUE        0x6DDC


// ============================================================
// DISPLAY DIMENSIONS
// ============================================================

#define SCREEN_W 320
#define SCREEN_H 240

#define HEADER_H 28

#define NAV_Y 208
#define NAV_H 32


// ============================================================
// HEALTH SCORE
// ============================================================

float fertilityScore = 0.0;

char fertilityGrade = 'D';


// ============================================================
// CROP RECOMMENDATION
// ============================================================

String recommendedCrop = "Waiting";
String cropTier = "Waiting";

// [TINYML ADDED] last result of the on-device neural network
int     tinyCropIdx = -1;     // index into TINYML_CROPS (-1 = no scan yet)
uint8_t tinyConfPct = 0;      // confidence 0..100

// [TINYML ADDED] results of the other two on-device networks
int      tinyTop[3]  = { -1, -1, -1 };   // top-3 crops (indexes into TINYML_CROPS)
uint8_t  tinyPct[3]  = { 0, 0, 0 };      // their confidences
bool     tinyOdd     = false;            // probe check: reading does not look like real soil
float    tinyErr     = 0.0f;             // probe check reconstruction error
uint16_t tinyAdvice  = 0;                // advisor bit mask (see TINYML_ADVICE[])


// ============================================================
// HELPER - CENTERED TEXT
// ============================================================

void printCentered(
  int16_t cx,
  int16_t y,
  const String &text,
  uint8_t size,
  uint16_t color
) {

  tft.setTextSize(size);

  int16_t x1;
  int16_t y1;

  uint16_t w;
  uint16_t h;

  tft.getTextBounds(
    text.c_str(),
    0,
    0,
    &x1,
    &y1,
    &w,
    &h
  );

  tft.setTextColor(color);

  tft.setCursor(
    cx - w / 2,
    y
  );

  tft.print(text);
}


// ============================================================
// STATUS COLOR
// ============================================================

uint16_t statusColor(int status) {

  if (status == 0)
    return COL_ACCENT;

  if (status == 1)
    return COL_AMBER;

  return COL_RED;
}


// ============================================================
// GRADE COLOR
// ============================================================

uint16_t gradeColor(float score) {

  if (score >= 65)
    return COL_ACCENT;

  if (score >= 45)
    return COL_AMBER;

  return COL_RED;
}


// ============================================================
// FERTILITY SCORE
// ============================================================

float calculateFertility() {

  int score = 0;

  if (
    nitrogen >= 40 &&
    nitrogen <= 120
  ) {
    score++;
  }

  if (
    phosphorus >= 40 &&
    phosphorus <= 120
  ) {
    score++;
  }

  if (
    potassium >= 40 &&
    potassium <= 120
  ) {
    score++;
  }

  if (
    soilPH >= 5.5 &&
    soilPH <= 7.5
  ) {
    score++;
  }

  if (
    soilTemperature >= 20 &&
    soilTemperature <= 35
  ) {
    score++;
  }

  if (
    soilHumidity >= 50 &&
    soilHumidity <= 90
  ) {
    score++;
  }

  // Same 6 checks as the website (calculate_fertility in app.py).
  // The prototype has no rainfall input, so there is no 7th point.
  return (score / 6.0) * 100.0;
}


// ============================================================
// FERTILITY GRADE
// ============================================================

char getGrade(float score) {

  if (score >= 85)
    return 'A';

  if (score >= 65)
    return 'B';

  if (score >= 45)
    return 'C';

  return 'D';
}


// ============================================================
// SENSOR STATUS
// ============================================================

int getPHStatus() {

  if (
    soilPH >= 6.0 &&
    soilPH <= 7.0
  )
    return 0;

  if (
    soilPH >= 5.5 &&
    soilPH <= 7.5
  )
    return 1;

  return 2;
}


int getHumidityStatus() {

  if (
    soilHumidity >= 50 &&
    soilHumidity <= 90
  )
    return 0;

  if (
    soilHumidity >= 40 &&
    soilHumidity <= 95
  )
    return 1;

  return 2;
}


int getTemperatureStatus() {

  if (
    soilTemperature >= 20 &&
    soilTemperature <= 35
  )
    return 0;

  if (
    soilTemperature >= 15 &&
    soilTemperature <= 40
  )
    return 1;

  return 2;
}


// Website presets (READING_RANGES in app.py):
//   N, P : optimal 40-120, watch 25-130
//   K    : optimal 40-120, watch 25-150
int getNPKStatus(uint16_t value, uint16_t watchMax) {

  if (
    value >= 40 &&
    value <= 120
  )
    return 0;

  if (
    value >= 25 &&
    value <= watchMax
  )
    return 1;

  return 2;
}


// ============================================================
// [SCAN ADDED] SCAN NOW BUTTON (top bar, x 118..228, y 3..25)
// ============================================================

void drawScanButton() {

  const int bx = 118;
  const int by = 3;
  const int bw = 110;
  const int bh = 22;

  uint16_t fill   = COL_ACCENT;
  uint16_t border = COL_ACCENT;
  uint16_t txt    = COL_BG;
  const char* label = "Scan now";

  if (scanBtnState == BTN_SCANNING) {
    fill = COL_AMBER;  border = COL_AMBER;  txt = COL_BG;  label = "Scanning...";
  }
  else if (scanBtnState == BTN_SENDING) {
    fill = COL_BLUE;   border = COL_BLUE;   txt = COL_BG;  label = "Sending...";
  }
  else if (scanBtnState == BTN_SENT) {
    fill = COL_ACCENT_DIM; border = COL_ACCENT; txt = COL_ACCENT; label = "Sent!";
  }
  else if (scanBtnState == BTN_FAILED) {
    fill = COL_BG_RAISED;  border = COL_RED;    txt = COL_RED;    label = "Send failed";
  }
  else if (scanBtnState == BTN_NO_SENSOR) {
    fill = COL_BG_RAISED;  border = COL_RED;    txt = COL_RED;    label = "No sensor";
  }
  else if (scanBtnState == BTN_NO_WIFI) {
    fill = COL_BG_RAISED;  border = COL_RED;    txt = COL_RED;    label = "No Wi-Fi";
  }
  else if (scanBtnState == BTN_SAVED) {
    fill = COL_BG_RAISED;  border = COL_AMBER;  txt = COL_AMBER;  label = "Saved offline";
  }
  else if (scanBtnState == BTN_SYNCING) {
    fill = COL_BLUE;       border = COL_BLUE;   txt = COL_BG;     label = "Syncing...";
  }

  // [OFFLINE ADDED] idle button shows how many scans are waiting for Wi-Fi
  char pendingLabel[24];
  if (scanBtnState == BTN_IDLE && offlineCountPending() > 0) {
    snprintf(pendingLabel, sizeof(pendingLabel), "Scan now (%d saved)", offlineCountPending());
    label = pendingLabel;
  }

  tft.fillRoundRect(bx, by, bw, bh, 6, fill);
  tft.drawRoundRect(bx, by, bw, bh, 6, border);

  printCentered(bx + bw / 2, by + 7, String(label), 1, txt);
}


// holdMs > 0 = show this state for a moment, then go back to "Scan now"
void setScanBtn(int state, unsigned long holdMs) {

  scanBtnState = state;

  scanBtnResetAt = holdMs ? millis() + holdMs : 0;

  drawScanButton();
}


// ============================================================
// DRAW HEADER
// ============================================================

void drawHeader() {

  tft.fillRect(
    0,
    0,
    SCREEN_W,
    HEADER_H,
    COL_BG_RAISED
  );

  tft.drawFastHLine(
    0,
    HEADER_H,
    SCREEN_W,
    COL_BORDER_LO
  );


  // Logo

  tft.fillRoundRect(
    7,
    5,
    18,
    18,
    4,
    COL_ACCENT
  );

  tft.setTextColor(
    COL_BG
  );

  tft.setTextSize(1);

  tft.setCursor(
    12,
    10
  );

  tft.print("S");


  // Logo name

  tft.setTextColor(
    COL_TEXT
  );

  tft.setCursor(
    31,
    10
  );

  tft.print("SoilSense");

  // [OFFLINE ADDED] amber tag while there is no Wi-Fi (scans are still saved)
  if (appState == APP_READY && WiFi.status() != WL_CONNECTED) {
    tft.setTextColor(COL_AMBER);
    tft.setCursor(89, 10);
    tft.print("OFF");
  }


  // Sensor status

  uint16_t sensorStatusColor;

  if (!hasScanned)
    sensorStatusColor = COL_MUTED;
  else if (sensorOK && tinyOdd)
    sensorStatusColor = COL_AMBER;
  else if (sensorOK)
    sensorStatusColor = COL_ACCENT;
  else
    sensorStatusColor = COL_RED;

  tft.fillCircle(
    250,
    14,
    3,
    sensorStatusColor
  );

  tft.setTextColor(
    sensorStatusColor
  );

  tft.setCursor(
    258,
    10
  );

  if (!hasScanned)
    tft.print("Ready");
  else if (sensorOK && tinyOdd)
    tft.print("Odd value");          // [TINYML] probe check: re-insert the probe
  else if (sensorOK)
    tft.print("Sensor OK");
  else
    tft.print("No Sensor");

  // [SCAN ADDED]
  drawScanButton();
}


// ============================================================
// DRAW HEALTH RING
// ============================================================

void drawHealthRing(
  float score,
  char grade
) {

  int cx = 52;
  int cy = 92;

  int radius = 39;


  tft.drawCircle(
    cx,
    cy,
    radius,
    COL_PANEL_HI
  );

  tft.drawCircle(
    cx,
    cy,
    radius - 1,
    COL_PANEL_HI
  );


  float percentage =
    constrain(score, 0, 100) / 100.0;

  int segments =
    percentage * 36;


  for (
    int i = 0;
    i < segments;
    i++
  ) {

    float angle =
      (-90.0 + i * 10.0) *
      DEG_TO_RAD;

    int x =
      cx + cos(angle) * radius;

    int y =
      cy + sin(angle) * radius;

    tft.fillCircle(
      x,
      y,
      4,
      gradeColor(score)
    );
  }


  printCentered(
    cx,
    cy - 12,
    String((int)score),
    2,
    COL_TEXT
  );


  printCentered(
    cx,
    cy + 8,
    "/100",
    1,
    COL_MUTED
  );


  String gradeText =
    "Grade " +
    String(grade);

  printCentered(
    cx,
    cy + 54,
    gradeText,
    1,
    gradeColor(score)
  );


  printCentered(
    cx,
    cy + 70,
    "SOIL HEALTH",
    1,
    COL_MUTED
  );
}


// ============================================================
// DRAW READING CARD
// ============================================================

void drawReadingCard(
  int x,
  int y,
  const String &label,
  const String &value,
  const String &unit,
  int status
) {

  int w = 101;
  int h = 33;


  tft.fillRoundRect(
    x,
    y,
    w,
    h,
    5,
    COL_PANEL
  );

  tft.drawRoundRect(
    x,
    y,
    w,
    h,
    5,
    COL_BORDER_LO
  );


  // Status dot

  tft.fillCircle(
    x + w - 8,
    y + 8,
    3,
    statusColor(status)
  );


  // Label

  tft.setTextColor(
    COL_MUTED
  );

  tft.setTextSize(1);

  tft.setCursor(
    x + 6,
    y + 5
  );

  tft.print(label);


  // Value

  tft.setTextColor(
    COL_TEXT
  );

  tft.setCursor(
    x + 6,
    y + 18
  );

  tft.print(value);
  tft.print(unit);
}


// ============================================================
// DRAW CROP BANNER
// ============================================================

void drawCropBanner() {

  int x = 6;
  int y = 174;
  int w = 308;
  int h = 30;


  tft.fillRoundRect(
    x,
    y,
    w,
    h,
    6,
    COL_ACCENT_DIM
  );

  tft.drawRoundRect(
    x,
    y,
    w,
    h,
    6,
    COL_BORDER
  );


  tft.setTextColor(
    COL_MUTED
  );

  tft.setTextSize(1);

  tft.setCursor(
    x + 9,
    y + 4
  );

  tft.print(
    "Recommended crop"
  );


  String crop =
    recommendedCrop;

  if (
    crop.length() > 0
  ) {

    crop.setCharAt(
      0,
      toupper(
        crop.charAt(0)
      )
    );
  }


  tft.setTextColor(
    COL_TEXT
  );

  tft.setTextSize(2);

  tft.setCursor(
    x + 9,
    y + 14
  );

  tft.print(crop);


  tft.setTextColor(
    COL_ACCENT
  );

  tft.setTextSize(1);

  tft.setCursor(
    260,
    y + 7
  );

  tft.print(
    cropTier
  );
}


// ============================================================
// DRAW NAVIGATION
// ============================================================

void drawNavigation() {

  int buttonY = NAV_Y;
  int buttonH = NAV_H;

  int leftX = 5;
  int middleX = 110;
  int rightX = 215;

  int buttonW = 100;


  // SOIL

  if (currentScreen == 1) {

    tft.fillRoundRect(
      leftX,
      buttonY,
      buttonW,
      buttonH,
      6,
      COL_ACCENT_DIM
    );

    tft.drawRoundRect(
      leftX,
      buttonY,
      buttonW,
      buttonH,
      6,
      COL_ACCENT
    );

  } else {

    tft.fillRoundRect(
      leftX,
      buttonY,
      buttonW,
      buttonH,
      6,
      COL_PANEL
    );

    tft.drawRoundRect(
      leftX,
      buttonY,
      buttonW,
      buttonH,
      6,
      COL_BORDER_LO
    );
  }


  // HOME

  if (currentScreen == 0) {

    tft.fillRoundRect(
      middleX,
      buttonY,
      buttonW,
      buttonH,
      6,
      COL_ACCENT_DIM
    );

    tft.drawRoundRect(
      middleX,
      buttonY,
      buttonW,
      buttonH,
      6,
      COL_ACCENT
    );

  } else {

    tft.fillRoundRect(
      middleX,
      buttonY,
      buttonW,
      buttonH,
      6,
      COL_PANEL
    );

    tft.drawRoundRect(
      middleX,
      buttonY,
      buttonW,
      buttonH,
      6,
      COL_BORDER_LO
    );
  }


  // NPK

  if (currentScreen == 2) {

    tft.fillRoundRect(
      rightX,
      buttonY,
      buttonW,
      buttonH,
      6,
      COL_ACCENT_DIM
    );

    tft.drawRoundRect(
      rightX,
      buttonY,
      buttonW,
      buttonH,
      6,
      COL_ACCENT
    );

  } else {

    tft.fillRoundRect(
      rightX,
      buttonY,
      buttonW,
      buttonH,
      6,
      COL_PANEL
    );

    tft.drawRoundRect(
      rightX,
      buttonY,
      buttonW,
      buttonH,
      6,
      COL_BORDER_LO
    );
  }


  // TEXT

  tft.setTextSize(1);


  tft.setTextColor(
    currentScreen == 1 ?
    COL_ACCENT :
    COL_MUTED
  );

  tft.setCursor(
    45,
    220
  );

  tft.print("SOIL");


  tft.setTextColor(
    currentScreen == 0 ?
    COL_ACCENT :
    COL_MUTED
  );

  tft.setCursor(
    151,
    220
  );

  tft.print("HOME");


  tft.setTextColor(
    currentScreen == 2 ?
    COL_ACCENT :
    COL_MUTED
  );

  tft.setCursor(
    255,
    220
  );

  tft.print("NPK");
}


// ============================================================
// DASHBOARD - FULL DRAW
// ============================================================

void drawDashboard() {

  tft.fillScreen(
    COL_BG
  );

  drawHeader();

  drawHealthRing(
    fertilityScore,
    fertilityGrade
  );


  drawReadingCard(
    106,
    32,
    "pH",
    String(soilPH, 1),
    "",
    getPHStatus()
  );

  drawReadingCard(
    210,
    32,
    "Moisture",
    String(soilHumidity, 0),
    "%",
    getHumidityStatus()
  );


  drawReadingCard(
    106,
    68,
    "Temperature",
    String(soilTemperature, 1),
    " C",
    getTemperatureStatus()
  );

  drawReadingCard(
    210,
    68,
    "Nitrogen",
    String(nitrogen),
    " mg/kg",
    getNPKStatus(nitrogen, 130)
  );


  drawReadingCard(
    106,
    104,
    "Phosphorus",
    String(phosphorus),
    " mg/kg",
    getNPKStatus(phosphorus, 130)
  );

  drawReadingCard(
    210,
    104,
    "Potassium",
    String(potassium),
    " mg/kg",
    getNPKStatus(potassium, 150)
  );


  drawReadingCard(
    106,
    140,
    "Conductivity",
    String(soilConductivity),
    "",
    0
  );


  if (sensorOK || !hasScanned) {

    drawReadingCard(
      210,
      140,
      "Status",
      "Ready",
      "",
      0
    );

  } else {

    drawReadingCard(
      210,
      140,
      "Status",
      "Error",
      "",
      2
    );
  }


  drawCropBanner();

  drawNavigation();
}


// ============================================================
// SOIL SCREEN - FULL DRAW
// ============================================================

void drawSoilScreen() {

  tft.fillScreen(
    COL_BG
  );

  drawHeader();


  tft.setTextColor(
    COL_TEXT
  );

  tft.setTextSize(2);

  tft.setCursor(
    10,
    38
  );

  tft.print(
    "Soil Conditions"
  );


  drawReadingCard(
    10,
    72,
    "pH",
    String(soilPH, 1),
    "",
    getPHStatus()
  );


  drawReadingCard(
    114,
    72,
    "Moisture",
    String(soilHumidity, 1),
    "%",
    getHumidityStatus()
  );


  drawReadingCard(
    218,
    72,
    "Temperature",
    String(soilTemperature, 1),
    " C",
    getTemperatureStatus()
  );


  drawReadingCard(
    10,
    116,
    "Conductivity",
    String(soilConductivity),
    "",
    0
  );


  // Soil health panel

  tft.fillRoundRect(
    114,
    116,
    205,
    33,
    5,
    COL_PANEL
  );

  tft.drawRoundRect(
    114,
    116,
    205,
    33,
    5,
    COL_BORDER_LO
  );

  tft.setTextColor(
    COL_MUTED
  );

  tft.setTextSize(1);

  tft.setCursor(
    122,
    122
  );

  tft.print(
    "Soil health"
  );

  tft.setTextColor(
    gradeColor(fertilityScore)
  );

  tft.setTextSize(2);

  tft.setCursor(
    122,
    134
  );

  tft.print(
    String((int)fertilityScore)
  );

  tft.print(
    "/100"
  );


  drawNavigation();
}


// ============================================================
// NPK SCREEN - FULL DRAW
// ============================================================

void drawNPKScreen() {

  tft.fillScreen(
    COL_BG
  );

  drawHeader();


  tft.setTextColor(
    COL_TEXT
  );

  tft.setTextSize(2);

  tft.setCursor(
    10,
    38
  );

  tft.print(
    "NPK Levels"
  );


  drawReadingCard(
    10,
    75,
    "Nitrogen",
    String(nitrogen),
    " mg/kg",
    getNPKStatus(nitrogen, 130)
  );


  drawReadingCard(
    114,
    75,
    "Phosphorus",
    String(phosphorus),
    " mg/kg",
    getNPKStatus(phosphorus, 130)
  );


  drawReadingCard(
    218,
    75,
    "Potassium",
    String(potassium),
    " mg/kg",
    getNPKStatus(potassium, 150)
  );


  // NPK summary

  tft.fillRoundRect(
    10,
    125,
    309,
    45,
    6,
    COL_PANEL
  );

  tft.drawRoundRect(
    10,
    125,
    309,
    45,
    6,
    COL_BORDER_LO
  );


  tft.setTextColor(
    COL_MUTED
  );

  tft.setTextSize(1);

  tft.setCursor(
    20,
    134
  );

  tft.print(
    "N - P - K"
  );


  tft.setTextColor(
    COL_TEXT
  );

  tft.setTextSize(2);

  tft.setCursor(
    20,
    148
  );

  tft.print(
    String(nitrogen)
  );

  tft.print(" / ");

  tft.print(
    String(phosphorus)
  );

  tft.print(" / ");

  tft.print(
    String(potassium)
  );


  drawNavigation();
}


// ============================================================
// UPDATE DASHBOARD VALUES ONLY
// ============================================================

void updateDashboardValues() {

  // ----------------------------------------------------------
  // UPDATE READING CARDS
  // ----------------------------------------------------------

  drawReadingCard(
    106,
    32,
    "pH",
    String(soilPH, 1),
    "",
    getPHStatus()
  );

  drawReadingCard(
    210,
    32,
    "Moisture",
    String(soilHumidity, 0),
    "%",
    getHumidityStatus()
  );


  drawReadingCard(
    106,
    68,
    "Temperature",
    String(soilTemperature, 1),
    " C",
    getTemperatureStatus()
  );

  drawReadingCard(
    210,
    68,
    "Nitrogen",
    String(nitrogen),
    " mg/kg",
    getNPKStatus(nitrogen, 130)
  );


  drawReadingCard(
    106,
    104,
    "Phosphorus",
    String(phosphorus),
    " mg/kg",
    getNPKStatus(phosphorus, 130)
  );

  drawReadingCard(
    210,
    104,
    "Potassium",
    String(potassium),
    " mg/kg",
    getNPKStatus(potassium, 150)
  );


  drawReadingCard(
    106,
    140,
    "Conductivity",
    String(soilConductivity),
    "",
    0
  );


  if (sensorOK || !hasScanned) {

    drawReadingCard(
      210,
      140,
      "Status",
      "Ready",
      "",
      0
    );

  } else {

    drawReadingCard(
      210,
      140,
      "Status",
      "Error",
      "",
      2
    );
  }


  // ----------------------------------------------------------
  // UPDATE HEALTH RING ONLY
  // ----------------------------------------------------------

  tft.fillRect(
    5,
    30,
    94,
    142,
    COL_BG
  );

  drawHealthRing(
    fertilityScore,
    fertilityGrade
  );


  // ----------------------------------------------------------
  // UPDATE HEADER STATUS
  // ----------------------------------------------------------

  drawHeader();


  // ----------------------------------------------------------
  // UPDATE CROP RECOMMENDATION
  // ----------------------------------------------------------

  drawCropBanner();
}


// ============================================================
// UPDATE SOIL VALUES ONLY
// ============================================================

void updateSoilValues() {

  drawReadingCard(
    10,
    72,
    "pH",
    String(soilPH, 1),
    "",
    getPHStatus()
  );


  drawReadingCard(
    114,
    72,
    "Moisture",
    String(soilHumidity, 1),
    "%",
    getHumidityStatus()
  );


  drawReadingCard(
    218,
    72,
    "Temperature",
    String(soilTemperature, 1),
    " C",
    getTemperatureStatus()
  );


  drawReadingCard(
    10,
    116,
    "Conductivity",
    String(soilConductivity),
    "",
    0
  );


  // ----------------------------------------------------------
  // UPDATE SOIL HEALTH PANEL
  // ----------------------------------------------------------

  tft.fillRoundRect(
    114,
    116,
    205,
    33,
    5,
    COL_PANEL
  );

  tft.drawRoundRect(
    114,
    116,
    205,
    33,
    5,
    COL_BORDER_LO
  );


  tft.setTextColor(
    COL_MUTED
  );

  tft.setTextSize(1);

  tft.setCursor(
    122,
    122
  );

  tft.print(
    "Soil health"
  );


  tft.setTextColor(
    gradeColor(fertilityScore)
  );

  tft.setTextSize(2);

  tft.setCursor(
    122,
    134
  );

  tft.print(
    String((int)fertilityScore)
  );

  tft.print(
    "/100"
  );


  // Header sensor status

  drawHeader();
}


// ============================================================
// UPDATE NPK VALUES ONLY
// ============================================================

void updateNPKValues() {

  drawReadingCard(
    10,
    75,
    "Nitrogen",
    String(nitrogen),
    " mg/kg",
    getNPKStatus(nitrogen, 130)
  );


  drawReadingCard(
    114,
    75,
    "Phosphorus",
    String(phosphorus),
    " mg/kg",
    getNPKStatus(phosphorus, 130)
  );


  drawReadingCard(
    218,
    75,
    "Potassium",
    String(potassium),
    " mg/kg",
    getNPKStatus(potassium, 150)
  );


  // ----------------------------------------------------------
  // UPDATE NPK SUMMARY
  // ----------------------------------------------------------

  tft.fillRoundRect(
    10,
    125,
    309,
    45,
    6,
    COL_PANEL
  );

  tft.drawRoundRect(
    10,
    125,
    309,
    45,
    6,
    COL_BORDER_LO
  );


  tft.setTextColor(
    COL_MUTED
  );

  tft.setTextSize(1);

  tft.setCursor(
    20,
    134
  );

  tft.print(
    "N - P - K"
  );


  tft.setTextColor(
    COL_TEXT
  );

  tft.setTextSize(2);

  tft.setCursor(
    20,
    148
  );

  tft.print(
    String(nitrogen)
  );

  tft.print(" / ");

  tft.print(
    String(phosphorus)
  );

  tft.print(" / ");

  tft.print(
    String(potassium)
  );


  // Header sensor status

  drawHeader();
}


// ============================================================
// DRAW CURRENT SCREEN
// ============================================================

void drawScreen() {

  if (currentScreen == 0) {

    drawDashboard();

  }

  else if (currentScreen == 1) {

    drawSoilScreen();

  }

  else if (currentScreen == 2) {

    drawNPKScreen();
  }
}


// ============================================================
// READ TOUCH
// ============================================================

bool readTouch(
  int &x,
  int &y
) {

  Wire.beginTransmission(
    FT6336_ADDR
  );

  Wire.write(0x02);

  if (
    Wire.endTransmission(false) != 0
  ) {

    return false;
  }


  if (
    Wire.requestFrom(
      FT6336_ADDR,
      5
    ) != 5
  ) {

    return false;
  }


  byte touchCount =
    Wire.read();

  byte xHigh =
    Wire.read();

  byte xLow =
    Wire.read();

  byte yHigh =
    Wire.read();

  byte yLow =
    Wire.read();


  if (
    touchCount == 0
  ) {

    return false;
  }


  int rawX =
    ((xHigh & 0x0F) << 8) |
    xLow;

  int rawY =
    ((yHigh & 0x0F) << 8) |
    yLow;


  // LANDSCAPE TRANSFORMATION

  x = rawY;

  y = 239 - rawX;


  x = constrain(
    x,
    0,
    319
  );

  y = constrain(
    y,
    0,
    239
  );


  return true;
}


// ============================================================
// HANDLE TOUCH
// ============================================================

void handleTouch() {

  bool touched =
    readTouch(
      touchX,
      touchY
    );


  if (
    touched &&
    !previousTouch
  ) {

    Serial.print(
      "Touch RAW/MAPPED -> X: "
    );

    Serial.print(
      touchX
    );

    Serial.print(
      "  Y: "
    );

    Serial.println(
      touchY
    );


    // [SCAN ADDED] SCAN NOW (top bar)

    if (
      touchY <= 30 &&
      touchX >= 105 &&
      touchX <= 240
    ) {

      Serial.println(
        "TOUCH: SCAN NOW"
      );

      doScan();
    }


    // SOIL

    else if (
      touchY >= 208 &&
      touchY <= 239 &&
      touchX >= 5 &&
      touchX < 105
    ) {

      Serial.println(
        "TOUCH: SOIL"
      );


      if (currentScreen != 1) {

        currentScreen = 1;

        drawScreen();
      }
    }


    // HOME

    else if (
      touchY >= 208 &&
      touchY <= 239 &&
      touchX >= 110 &&
      touchX < 210
    ) {

      Serial.println(
        "TOUCH: HOME"
      );


      if (currentScreen != 0) {

        currentScreen = 0;

        drawScreen();
      }
    }


    // NPK

    else if (
      touchY >= 208 &&
      touchY <= 239 &&
      touchX >= 215
    ) {

      Serial.println(
        "TOUCH: NPK"
      );


      if (currentScreen != 2) {

        currentScreen = 2;

        drawScreen();
      }
    }

    else {

      Serial.println(
        "TOUCH: outside navigation"
      );
    }
  }


  // [LINK ADDED] hold the "SoilSense" logo for 1.5 s = switch user

  if (touched && !previousTouch) {

    touchStartMs = millis();

    longPressDone = false;
  }

  if (
    touched &&
    !longPressDone &&
    touchX < 100 &&
    touchY < HEADER_H &&
    millis() - touchStartMs > 1500
  ) {

    longPressDone = true;

    switchUser();
  }


  previousTouch =
    touched;
}


// ============================================================
// READ NPK SENSOR
// ============================================================

void readNPKSensor() {

  while (
    Serial2.available()
  ) {

    Serial2.read();
  }


  Serial.println();
  Serial.println(
    "Sending request..."
  );


  // TRANSMIT

  digitalWrite(
    RE_DE_PIN,
    HIGH
  );

  delay(5);


  Serial2.write(
    query,
    sizeof(query)
  );

  Serial2.flush();


  // RECEIVE

  digitalWrite(
    RE_DE_PIN,
    LOW
  );

  delay(5);


  int bytesRead = 0;

  unsigned long startTime =
    millis();


  while (
    millis() - startTime < 1500
  ) {

    if (
      Serial2.available()
    ) {

      if (
        bytesRead <
        sizeof(response)
      ) {

        response[bytesRead] =
          Serial2.read();

        bytesRead++;

      }

      else {

        Serial2.read();
      }
    }
  }


  // RAW RESPONSE

  Serial.print(
    "Bytes Read: "
  );

  Serial.println(
    bytesRead
  );


  Serial.print(
    "Raw Response: "
  );


  for (
    int i = 0;
    i < bytesRead;
    i++
  ) {

    Serial.print(
      "0x"
    );

    if (
      response[i] < 0x10
    ) {

      Serial.print(
        "0"
      );
    }

    Serial.print(
      response[i],
      HEX
    );

    Serial.print(
      " "
    );
  }


  Serial.println();


  // FIND VALID MODBUS FRAME

  int startIndex = -1;


  for (
    int i = 0;
    i < bytesRead - 2;
    i++
  ) {

    if (
      response[i] == 0x01 &&
      response[i + 1] == 0x03 &&
      response[i + 2] == 0x0E
    ) {

      startIndex = i;

      break;
    }
  }


  // VALID FRAME

  if (
    startIndex >= 0 &&
    bytesRead - startIndex >= 19
  ) {

    Serial.println(
      "VALID SENSOR FRAME FOUND!"
    );


    uint16_t humidityRaw =
      ((uint16_t)
      response[startIndex + 3] << 8) |
      response[startIndex + 4];


    uint16_t temperatureRaw =
      ((uint16_t)
      response[startIndex + 5] << 8) |
      response[startIndex + 6];


    soilConductivity =
      ((uint16_t)
      response[startIndex + 7] << 8) |
      response[startIndex + 8];


    uint16_t phRaw =
      ((uint16_t)
      response[startIndex + 9] << 8) |
      response[startIndex + 10];


    nitrogen =
      ((uint16_t)
      response[startIndex + 11] << 8) |
      response[startIndex + 12];


    phosphorus =
      ((uint16_t)
      response[startIndex + 13] << 8) |
      response[startIndex + 14];


    potassium =
      ((uint16_t)
      response[startIndex + 15] << 8) |
      response[startIndex + 16];


    // CONVERT

    soilHumidity =
      humidityRaw / 10.0;

    soilTemperature =
      temperatureRaw / 10.0;

    soilPH =
      phRaw / 10.0;


    sensorOK = true;


    // FERTILITY

    fertilityScore =
      calculateFertility();

    fertilityGrade =
      getGrade(
        fertilityScore
      );


    // [TINYML] three small neural networks run ON the ESP32-S3 (no Wi-Fi needed)

    {
      // 1) crop recommender -> top 3 crops
      tinymlTop3(
        (float)nitrogen, (float)phosphorus, (float)potassium,
        soilTemperature, soilHumidity, soilPH,
        tinyTop, tinyPct
      );

      tinyCropIdx = tinyTop[0];
      tinyConfPct = tinyPct[0];

      recommendedCrop = TINYML_CROPS[tinyCropIdx];

      // same tier thresholds as the website: 85+ Excellent, 60+ Good, else Fair
      cropTier = (tinyConfPct >= 85) ? "Excellent" : (tinyConfPct >= 60) ? "Good" : "Fair";

      // 2) probe check -> does this look like real soil?
      tinyErr = tinymlProbeCheck(
        (float)nitrogen, (float)phosphorus, (float)potassium,
        soilTemperature, soilHumidity, soilPH,
        &tinyOdd
      );

      // 3) nutrient advisor -> what needs fixing
      tinyAdvice = tinymlAdvise(
        (float)nitrogen, (float)phosphorus, (float)potassium,
        soilTemperature, soilHumidity, soilPH
      );

      Serial.println();
      Serial.println("[TINYML] ---- on-device analysis ----");
      for (int r = 0; r < 3; r++) {
        Serial.print("[TINYML] Crop #"); Serial.print(r + 1); Serial.print(": ");
        Serial.print(TINYML_CROPS[tinyTop[r]]); Serial.print("  "); Serial.print(tinyPct[r]); Serial.println("%");
      }
      Serial.print("[TINYML] Probe check: ");
      Serial.print(tinyOdd ? "ODD VALUE - re-insert the probe and scan again" : "looks like real soil");
      Serial.print("  (error "); Serial.print(tinyErr, 3); Serial.println(")");
      Serial.print("[TINYML] Advisor: ");
      if (tinyAdvice == 0) Serial.println("nothing to fix");
      else {
        for (int k = 0; k < TINYML_N_ADV; k++) if (tinyAdvice & (1u << k)) { Serial.print(TINYML_ADVICE[k]); Serial.print("; "); }
        Serial.println();
      }
    }


    // SERIAL VALUES

    Serial.println();
    Serial.println(
      "===== SENSOR VALUES ====="
    );


    Serial.print(
      "Soil Humidity: "
    );

    Serial.print(
      soilHumidity
    );

    Serial.println(
      " %"
    );


    Serial.print(
      "Soil Temperature: "
    );

    Serial.print(
      soilTemperature
    );

    Serial.println(
      " C"
    );


    Serial.print(
      "Soil Conductivity: "
    );

    Serial.println(
      soilConductivity
    );


    Serial.print(
      "Soil pH: "
    );

    Serial.println(
      soilPH
    );


    Serial.print(
      "Nitrogen: "
    );

    Serial.print(
      nitrogen
    );

    Serial.println(
      " mg/kg"
    );


    Serial.print(
      "Phosphorus: "
    );

    Serial.print(
      phosphorus
    );

    Serial.println(
      " mg/kg"
    );


    Serial.print(
      "Potassium: "
    );

    Serial.print(
      potassium
    );

    Serial.println(
      " mg/kg"
    );


    Serial.print(
      "Health Score: "
    );

    Serial.print(
      fertilityScore
    );

    Serial.print(
      "/100 Grade "
    );

    Serial.println(
      fertilityGrade
    );
  }


  else {

    sensorOK = false;

    Serial.println(
      "NO VALID NPK FRAME FOUND!"
    );
  }
}


// ============================================================
// TOUCH INITIALIZATION
// ============================================================

void initTouch() {

  pinMode(
    CTP_RST,
    OUTPUT
  );


  digitalWrite(
    CTP_RST,
    LOW
  );

  delay(20);


  digitalWrite(
    CTP_RST,
    HIGH
  );

  delay(200);


  Wire.begin(
    CTP_SDA,
    CTP_SCL
  );


  Serial.println(
    "FT6336 touch initialized"
  );


  Wire.beginTransmission(
    FT6336_ADDR
  );


  if (
    Wire.endTransmission() == 0
  ) {

    Serial.println(
      "FT6336 detected!"
    );

  }

  else {

    Serial.println(
      "WARNING: FT6336 not detected!"
    );
  }
}


// ============================================================
// BOOT SCREEN
// ============================================================

void drawBootScreen() {

  tft.fillScreen(
    COL_BG
  );


  tft.fillRoundRect(
    138,
    45,
    44,
    44,
    10,
    COL_ACCENT
  );


  tft.setTextColor(
    COL_BG
  );

  tft.setTextSize(3);

  tft.setCursor(
    153,
    57
  );

  tft.print(
    "S"
  );


  printCentered(
    160,
    105,
    "SoilSense",
    2,
    COL_TEXT
  );


  printCentered(
    160,
    130,
    "TinyML Soil Platform",
    1,
    COL_MUTED
  );


  printCentered(
    160,
    158,
    "Starting sensors...",
    1,
    COL_FAINT
  );
}



// ============================================================
// [WIFI ADDED] WI-FI + WEBSITE LINK + SCAN UPLOAD (VERCEL)
// ------------------------------------------------------------
// Status messages go to the Serial Monitor; the LCD shows the
// link screen (code) and the Scan now button feedback.
// ============================================================

// ---- EDIT THESE 3 THINGS -----------------------------------

const char* WIFI_SSID     = "akoaypogi";        // 2.4 GHz network only
const char* WIFI_PASSWORD = "12345678";

// Your Vercel URL + /api/esp32  (must start with https://)
const char* SERVER_URL    = "https://bocaue.vercel.app/api/esp32";

// NOTE: there is no username / DEVICE_ID any more. Whoever links the
// device on the website (6-character code) receives the scans.

// ---- OPTIONAL ----------------------------------------------

// Leave "" for first test. If you later set ESP32_API_KEY in Vercel,
// put the same value here.
const char* API_KEY       = "";

// While the code is on screen, ask the website this often (ms)
const unsigned long LINK_POLL_MS = 4000;

// -------------------------------------------------------------

unsigned long lastWifiRetry   = 0;
bool          wifiWasUp       = false;

String        deviceToken     = "";   // secret ID, generated once, kept in flash
String        linkedUser      = "";   // website account that owns the device now
String        pairCode        = "";   // code currently drawn on the LCD ("" = not shown)
String        lastMsgKey      = "";   // avoids redrawing the same message screen
String        msgL1, msgL2, msgL3;    // [LCD FIX] last message text (to redraw after an LCD reset)
unsigned long lastLinkPoll    = 0;
unsigned long linkingSince    = 0;
int           lastUploadCode  = 0;
int           pairPanelX      = 0;    // text panel of the code screen
int           pairPanelW      = 0;


void wifiBegin() {

  WiFi.mode(WIFI_STA);
  WiFi.setAutoReconnect(true);
  WiFi.begin(WIFI_SSID, WIFI_PASSWORD);   // does NOT block
  applyWifiTxPower();                     // [LCD FIX]

  Serial.print("[WIFI] Connecting to ");
  Serial.println(WIFI_SSID);
}


void wifiWatch() {

  bool up = (WiFi.status() == WL_CONNECTED);

  if (up && !wifiWasUp) {
    Serial.print("[WIFI] Connected. IP: ");
    Serial.print(WiFi.localIP());
    Serial.print("  RSSI: ");
    Serial.print(WiFi.RSSI());
    Serial.println(" dBm");
  }

  if (!up && wifiWasUp) {
    Serial.println("[WIFI] Connection lost, retrying...");
  }

  wifiWasUp = up;

  if (!up && millis() - lastWifiRetry > 10000) {
    lastWifiRetry = millis();
    Serial.println("[WIFI] Not connected - retrying (check name/password, 2.4GHz)");
    WiFi.disconnect();
    WiFi.begin(WIFI_SSID, WIFI_PASSWORD);
    applyWifiTxPower();   // [LCD FIX]
  }
}


// ------------------------------------------------------------
// Device secret: 32 random hex characters, created on first boot
// and kept in flash (survives reboots and re-flashing the sketch,
// unless you choose "Erase All Flash" in the Arduino IDE).
// ------------------------------------------------------------

void loadOrCreateToken() {

  Preferences prefs;

  prefs.begin("soilsense", false);

  deviceToken = prefs.getString("token", "");

  if (deviceToken.length() != 32) {

    char buf[33];

    for (int i = 0; i < 4; i++) {
      snprintf(buf + i * 8, 9, "%08lx", (unsigned long)esp_random());
    }

    deviceToken = String(buf);

    prefs.putString("token", deviceToken);

    Serial.println("[LINK] Created a new device ID");
  }

  prefs.end();
}


// "https://x.vercel.app/api/esp32"  ->  "https://x.vercel.app" + path
String apiUrl(const char* path) {

  String base = SERVER_URL;

  int i = base.indexOf("/api/");

  if (i >= 0) base = base.substring(0, i);

  return base + path;
}


// One tiny HTTP helper used for linking AND for uploading scans.
// Returns the HTTP status code (negative = could not connect).
int httpPost(const String &url, const char* body, String &reply, uint32_t timeoutMs) {

  bool useHttps = url.startsWith("https://");

  WiFiClientSecure secureClient;
  WiFiClient       plainClient;
  HTTPClient       http;

  bool began;

  if (useHttps) {
    secureClient.setInsecure();   // skips certificate check (OK for testing)
    began = http.begin(secureClient, url);
  } else {
    began = http.begin(plainClient, url);
  }

  if (!began) {
    reply = "http.begin() failed";
    return -1;
  }

  // Vercel can take several seconds on a cold start
  http.setTimeout(timeoutMs);
  http.setFollowRedirects(HTTPC_STRICT_FOLLOW_REDIRECTS);
  http.addHeader("Content-Type", "application/json");
  http.addHeader("X-Device-Token", deviceToken);

  if (strlen(API_KEY) > 0) {
    http.addHeader("X-API-Key", API_KEY);
  }

  int code = http.POST((uint8_t*)body, strlen(body));

  if (code > 0) reply = http.getString();
  else          reply = http.errorToString(code);

  http.end();

  return code;
}


// Minimal JSON reader: finds  "key": value  and returns the value as text.
String jsonGet(const String &json, const char* key) {

  String k = String("\"") + key + "\"";

  int i = json.indexOf(k);
  if (i < 0) return "";

  i = json.indexOf(':', i + k.length());
  if (i < 0) return "";

  i++;
  while (i < (int)json.length() && (json[i] == ' ' || json[i] == '\n')) i++;

  if (i >= (int)json.length()) return "";

  if (json[i] == '"') {
    int e = json.indexOf('"', i + 1);
    return (e < 0) ? String("") : json.substring(i + 1, e);
  }

  int e = i;
  while (e < (int)json.length() && json[e] != ',' && json[e] != '}' && json[e] != ' ' && json[e] != '\n') e++;

  return json.substring(i, e);
}



// ============================================================
// [OFFLINE ADDED] NO WI-FI?  SAVE SCANS ON THE ESP32-S3, UPLOAD LATER
//
//  * At start-up, if no Wi-Fi (or no server) is found, the LCD asks
//    "Continue offline?".  Yes = main screens open, Scan now works.
//  * Every scan taken without Wi-Fi is stored in flash (survives
//    power-off) - up to OFFLINE_MAX_SCANS, oldest dropped when full.
//  * As soon as Wi-Fi + server are reachable, stored scans are sent
//    one by one, oldest first.  A scan is deleted from the device
//    ONLY after the server answered "200 OK".
//  * If the device was never linked, the code screen appears when
//    Wi-Fi returns; after linking, the saved scans go to that account.
// ============================================================

#define OFFLINE_MAX_SCANS       80
#define OFFLINE_PROMPT_AFTER_MS 12000   // no Wi-Fi for this long -> ask
#define OFFLINE_ASK_AGAIN_MS    60000   // after "Keep trying", ask again later
#define OFFLINE_SYNC_GAP_MS      1500   // pause between two uploads

struct OfflineScan {
  uint16_t n, p, k;
  float    ph, temp, hum;
  float    oddErr;     // probe-check error
  uint8_t  cropIdx;    // crop #1  (255 = none)
  uint8_t  confPct;
  uint8_t  crop2Idx, crop3Idx, conf2, conf3;
  uint8_t  odd;        // 1 = probe check said "odd value"
  uint16_t advice;     // advisor bit mask
  uint32_t bootId;     // which power-on the scan belongs to
  uint32_t tSec;       // seconds since that power-on
};

OfflineScan   offlineQ[OFFLINE_MAX_SCANS];
int           offlineCount     = 0;
uint32_t      bootId           = 0;
String        savedOwner       = "";     // last account this device was linked to
bool          offlinePromptOn  = false;
unsigned long offlineAskAfter  = 0;
int           serverFailCount  = 0;
unsigned long lastSyncTry      = 0;
unsigned long syncBackoffUntil = 0;
bool          syncedSomething  = false;

int offlineCountPending() { return offlineCount; }


// Copy the reading + TinyML results that are on screen into a record
void snapshotScan(OfflineScan &o) {
  o.n = nitrogen;  o.p = phosphorus;  o.k = potassium;
  o.ph = soilPH;   o.temp = soilTemperature;  o.hum = soilHumidity;
  o.oddErr   = tinyErr;
  o.cropIdx  = (tinyTop[0] >= 0) ? (uint8_t)tinyTop[0] : 255;
  o.confPct  = tinyPct[0];
  o.crop2Idx = (tinyTop[1] >= 0) ? (uint8_t)tinyTop[1] : 255;
  o.conf2    = tinyPct[1];
  o.crop3Idx = (tinyTop[2] >= 0) ? (uint8_t)tinyTop[2] : 255;
  o.conf3    = tinyPct[2];
  o.odd      = tinyOdd ? 1 : 0;
  o.advice   = tinyAdvice;
  o.bootId   = bootId;
  o.tSec     = millis() / 1000;
}

// JSON body shared by live uploads and saved (offline) uploads
int buildScanJson(char *dst, size_t cap, const OfflineScan &o, bool offline, const char *ageField, const char *uid) {
  const char *c1 = (o.cropIdx  < TINYML_N_OUT) ? TINYML_CROPS[o.cropIdx]  : "";
  const char *c2 = (o.crop2Idx < TINYML_N_OUT) ? TINYML_CROPS[o.crop2Idx] : "";
  const char *c3 = (o.crop3Idx < TINYML_N_OUT) ? TINYML_CROPS[o.crop3Idx] : "";
  return snprintf(
    dst, cap,
    "{\"N\":%u,\"P\":%u,\"K\":%u,\"ph\":%.1f,\"temp\":%.1f,\"humidity\":%.1f,"
    "\"crop\":\"%s\",\"crop_conf\":%u,\"crop2\":\"%s\",\"crop2_conf\":%u,\"crop3\":\"%s\",\"crop3_conf\":%u,"
    "\"odd\":%u,\"odd_err\":%.3f,\"advice\":%u,\"offline\":%s,%s\"scan_uid\":\"%s\"}",
    (unsigned)o.n, (unsigned)o.p, (unsigned)o.k, o.ph, o.temp, o.hum,
    c1, (unsigned)o.confPct, c2, (unsigned)o.conf2, c3, (unsigned)o.conf3,
    (unsigned)o.odd, o.oddErr, (unsigned)o.advice, offline ? "true" : "false", ageField, uid
  );
}

void offlineSave() {
  Preferences prefs;
  prefs.begin("soilsense", false);
  if (offlineCount == 0) prefs.remove("queue2");
  else prefs.putBytes("queue2", offlineQ, offlineCount * sizeof(OfflineScan));
  prefs.end();
}


void offlineLoad() {
  Preferences prefs;
  prefs.begin("soilsense", false);

  prefs.remove("queue");                       // older firmware's format (no TinyML fields)

  size_t len = prefs.getBytesLength("queue2");
  if (len > 0 && len % sizeof(OfflineScan) == 0 && len <= sizeof(offlineQ)) {
    prefs.getBytes("queue2", offlineQ, len);
    offlineCount = len / sizeof(OfflineScan);
  } else {
    offlineCount = 0;
  }

  bootId = prefs.getUInt("bootid", 0) + 1;
  prefs.putUInt("bootid", bootId);

  savedOwner = prefs.getString("owner", "");
  prefs.end();

  Serial.print("[OFFLINE] Boot #");
  Serial.print(bootId);
  Serial.print(", saved scans waiting: ");
  Serial.println(offlineCount);
}


void rememberOwner(const String &user) {
  savedOwner = user;
  Preferences prefs;
  prefs.begin("soilsense", false);
  prefs.putString("owner", user);
  prefs.end();
}


void forgetOwner() {
  savedOwner = "";
  Preferences prefs;
  prefs.begin("soilsense", false);
  prefs.remove("owner");
  prefs.end();
}


// Store the reading that is on screen right now
void offlineAdd() {

  if (offlineCount >= OFFLINE_MAX_SCANS) {
    for (int i = 1; i < offlineCount; i++) offlineQ[i - 1] = offlineQ[i];
    offlineCount--;
    Serial.println("[OFFLINE] Storage full - oldest saved scan dropped");
  }

  snapshotScan(offlineQ[offlineCount++]);

  offlineSave();

  Serial.print("[OFFLINE] Scan saved on the ESP32-S3. Waiting for upload: ");
  Serial.println(offlineCount);
}


// ---- "Continue offline?" screen ------------------------------------------

void drawOfflinePrompt() {

  offlinePromptOn = true;
  lastMsgKey      = "";
  pairCode        = "";

  tft.fillScreen(COL_BG);

  tft.fillRoundRect(138, 14, 44, 44, 10, COL_AMBER);
  printCentered(160, 26, String("S"), 3, COL_BG);

  printCentered(160, 72,  String("No Wi-Fi / no internet"), 2, COL_TEXT);
  printCentered(160, 98,  String("Continue offline?"), 2, COL_AMBER);

  printCentered(160, 126, String("Scans are saved on this device and"), 1, COL_MUTED);
  printCentered(160, 138, String("sent to the website once Wi-Fi is back."), 1, COL_MUTED);

  if (offlineCount > 0) {
    printCentered(160, 152, String(offlineCount) + " scan(s) already saved", 1, COL_FAINT);
  }

  tft.fillRoundRect(16, 172, 136, 44, 8, COL_ACCENT);
  printCentered(84, 188, String("Continue offline"), 1, COL_BG);

  tft.fillRoundRect(168, 172, 136, 44, 8, COL_BG_RAISED);
  tft.drawRoundRect(168, 172, 136, 44, 8, COL_BORDER);
  printCentered(236, 188, String("Keep trying Wi-Fi"), 1, COL_TEXT);
}


void enterOfflineMode() {

  offlinePromptOn = false;

  Serial.println("[OFFLINE] Continuing without Wi-Fi");

  linkedUser = savedOwner.length() ? savedOwner : String("offline");

  showMessage("Offline mode", "Scans are saved on the device", "They upload when Wi-Fi returns");

  delay(1800);

  lastMsgKey     = "";
  pairCode       = "";
  scanBtnState   = BTN_IDLE;
  scanBtnResetAt = 0;
  appState       = APP_READY;
  currentScreen  = 0;

  drawScreen();
}


// Called from pairingTick(): decides when to ask, and handles the two buttons
bool offlinePromptTick(bool wifiUp) {

  if (offlinePromptOn && wifiUp && serverFailCount < 3) {
    offlinePromptOn = false;              // Wi-Fi came back by itself
    lastMsgKey = "";
    return false;
  }

  bool trouble = (!wifiUp && millis() - linkingSince > OFFLINE_PROMPT_AFTER_MS) ||
                 (wifiUp && serverFailCount >= 3);

  if (!offlinePromptOn) {
    if (trouble && millis() > offlineAskAfter) drawOfflinePrompt();
    return offlinePromptOn;
  }

  // prompt is showing: wait for a tap
  static bool wasTouched = false;
  int tx = 0, ty = 0;
  bool t = readTouch(tx, ty);

  if (t && !wasTouched) {
    if (ty >= 168 && ty <= 220 && tx >= 12 && tx <= 156) {
      wasTouched = t;
      enterOfflineMode();
      return true;
    }
    if (ty >= 168 && ty <= 220 && tx >= 164 && tx <= 308) {
      offlinePromptOn = false;
      offlineAskAfter = millis() + OFFLINE_ASK_AGAIN_MS;
      serverFailCount = 0;
      lastMsgKey      = "";
      linkingSince    = millis();
    }
  }
  wasTouched = t;

  return offlinePromptOn;
}


// ---- upload the saved scans once the website is reachable --------------------

void offlineSyncTick() {

  if (offlineCount == 0) {
    if (syncedSomething && scanBtnState == BTN_IDLE) {
      syncedSomething = false;
      setScanBtn(BTN_SENT, 2500);       // "Sent!" = everything synced
    }
    return;
  }

  if (WiFi.status() != WL_CONNECTED) return;
  if (millis() < syncBackoffUntil)   return;
  if (millis() - lastSyncTry < OFFLINE_SYNC_GAP_MS) return;
  if (scanBtnState == BTN_SCANNING || scanBtnState == BTN_SENDING) return;

  lastSyncTry = millis();

  if (deviceToken.length() != 32) loadOrCreateToken();

  OfflineScan &o = offlineQ[0];

  // age of the scan (only known if it was taken during this power-on)
  char ageField[32] = "";
  if (o.bootId == bootId) {
    unsigned long nowSec = millis() / 1000;
    snprintf(ageField, sizeof(ageField), "\"age_s\":%lu,", (nowSec >= o.tSec) ? (nowSec - o.tSec) : 0UL);
  }

  char uid[40];
  snprintf(uid, sizeof(uid), "%s-%lu-%lu", deviceToken.substring(0, 8).c_str(), (unsigned long)o.bootId, (unsigned long)o.tSec);

  char body[640];
  buildScanJson(body, sizeof(body), o, true, ageField, uid);

  setScanBtn(BTN_SYNCING, 0);

  String reply;
  int code = httpPost(String(SERVER_URL), body, reply, 20000);

  Serial.print("[OFFLINE] Upload of saved scan -> HTTP ");
  Serial.println(code);

  if (code == 200) {
    for (int i = 1; i < offlineCount; i++) offlineQ[i - 1] = offlineQ[i];
    offlineCount--;
    offlineSave();
    syncedSomething = true;
    syncBackoffUntil = 0;
    setScanBtn(BTN_IDLE, 0);
    drawScanButton();
  }
  else if (code == 403) {
    // not linked (yet) -> show the code screen; saved scans stay on the device
    Serial.println("[OFFLINE] Device not linked - show link code, scans are kept");
    forgetOwner();
    setScanBtn(BTN_IDLE, 0);
    goPairing();
  }
  else {
    setScanBtn(BTN_IDLE, 0);
    syncBackoffUntil = millis() + 15000;   // try again in 15 s, scans stay saved
  }
}


// ------------------------------------------------------------
// Send the current reading to the website (called by Scan now)
// ------------------------------------------------------------

bool sendToWebsite() {

  lastUploadCode = 0;

  if (WiFi.status() != WL_CONNECTED) {
    Serial.println("[UPLOAD] Skipped - no Wi-Fi");
    return false;
  }

  // [TINYML] top-3 crops, probe check and advisor result travel with the reading
  OfflineScan snap;
  snapshotScan(snap);

  char body[640];
  buildScanJson(body, sizeof(body), snap, false, "", "");

  Serial.println("[UPLOAD] Sending:");
  Serial.println(body);

  String reply;

  unsigned long t0 = millis();
  int code = httpPost(String(SERVER_URL), body, reply, 20000);
  unsigned long took = millis() - t0;

  lastUploadCode = code;

  Serial.print("[UPLOAD] HTTP code: ");
  Serial.print(code);
  Serial.print("  (");
  Serial.print(took);
  Serial.println(" ms)");

  if (reply.length() > 350) reply = reply.substring(0, 350) + "...";
  Serial.println("[UPLOAD] Server reply:");
  Serial.println(reply);

  bool ok = (code == 200);

  Serial.println(ok ? "[UPLOAD] SUCCESS - saved on website"
                    : "[UPLOAD] FAILED - see code/reply above");
  return ok;
}


// ------------------------------------------------------------
// SCAN NOW: read the NPK sensor once, show it, send it
// ------------------------------------------------------------

void refreshValues() {

  if (currentScreen == 0) {
    updateDashboardValues();
  }
  else if (currentScreen == 1) {
    updateSoilValues();
  }
  else if (currentScreen == 2) {
    updateNPKValues();
  }
}


void doScan() {

  Serial.println("[SCAN] Scan now pressed");

  setScanBtn(BTN_SCANNING, 0);

  readNPKSensor();

  hasScanned = true;

  drawHeader();          // refreshes the "Sensor OK / No Sensor" text
  refreshValues();       // refreshes the numbers on the current screen

  if (!sensorOK) {
    setScanBtn(BTN_NO_SENSOR, 2500);
    return;
  }

  // [OFFLINE] no Wi-Fi -> keep the scan on the ESP32-S3, upload it later
  if (WiFi.status() != WL_CONNECTED) {
    offlineAdd();
    setScanBtn(BTN_SAVED, 2500);
    return;
  }

  setScanBtn(BTN_SENDING, 0);

  if (sendToWebsite()) {
    setScanBtn(BTN_SENT, 2500);
  }
  else if (lastUploadCode == 403) {
    // The account unlinked this device on the website -> back to the code screen
    // (the scan is kept so it is not lost)
    Serial.println("[LINK] Device is no longer linked");
    offlineAdd();
    forgetOwner();
    goPairing();
  }
  else if (lastUploadCode <= 0 || lastUploadCode >= 500) {
    // Wi-Fi is on but the website could not be reached -> same as offline
    offlineAdd();
    setScanBtn(BTN_SAVED, 2500);
  }
  else {
    setScanBtn(BTN_FAILED, 2500);
  }
}


// ------------------------------------------------------------
// LINK SCREEN (6-character code)
// ------------------------------------------------------------

void resetReadings() {

  soilHumidity     = 0;
  soilTemperature  = 0;
  soilPH           = 0;
  soilConductivity = 0;
  nitrogen         = 0;
  phosphorus       = 0;
  potassium        = 0;

  sensorOK         = false;
  hasScanned       = false;

  fertilityScore   = 0;
  fertilityGrade   = 'D';

  recommendedCrop  = "Waiting";
  cropTier         = "Waiting";
  tinyCropIdx      = -1;
  tinyConfPct      = 0;
  tinyTop[0] = tinyTop[1] = tinyTop[2] = -1;
  tinyPct[0] = tinyPct[1] = tinyPct[2] = 0;
  tinyOdd = false;  tinyErr = 0;  tinyAdvice = 0;
}


// Plain message screen (logo + up to 3 lines). Only redraws when the text changes.
void showMessage(const String &l1, const String &l2, const String &l3) {

  String key = l1 + "|" + l2 + "|" + l3;

  if (key == lastMsgKey) return;

  lastMsgKey = key;
  msgL1 = l1;  msgL2 = l2;  msgL3 = l3;   // [LCD FIX]
  pairCode   = "";            // the code screen is no longer showing

  tft.fillScreen(COL_BG);

  tft.fillRoundRect(138, 40, 44, 44, 10, COL_ACCENT);

  printCentered(160, 52, String("S"), 3, COL_BG);

  printCentered(160, 106, l1, 2, COL_TEXT);
  printCentered(160, 136, l2, 1, COL_MUTED);
  printCentered(160, 152, l3, 1, COL_FAINT);
}


// Small status line at the bottom of the code screen
void setPairStatus(const String &text) {

  tft.fillRect(0, 212, SCREEN_W, 20, COL_BG);

  tft.setTextSize(1);
  tft.setTextColor(COL_MUTED);
  tft.setCursor(pairPanelX, 218);
  tft.print(text);
}


void drawPairingScreen(const String &code) {

  tft.fillScreen(COL_BG);

  // Title bar

  tft.fillRect(0, 0, SCREEN_W, HEADER_H, COL_BG_RAISED);
  tft.drawFastHLine(0, HEADER_H, SCREEN_W, COL_BORDER_LO);

  tft.fillRoundRect(7, 5, 18, 18, 4, COL_ACCENT);

  tft.setTextColor(COL_BG);
  tft.setTextSize(1);
  tft.setCursor(12, 10);
  tft.print("S");

  tft.setTextColor(COL_TEXT);
  tft.setCursor(31, 10);
  tft.print("Link this device to your account");

  pairPanelX = 20;
  pairPanelW = SCREEN_W - 40;

  // Instructions

  printCentered(160, 48, String("On the website, open"), 1, COL_MUTED);
  printCentered(160, 62, String("Link Device and enter this code:"), 1, COL_MUTED);

  // The code, big, in a framed box

  tft.fillRoundRect(40, 90, 240, 64, 10, COL_PANEL);
  tft.drawRoundRect(40, 90, 240, 64, 10, COL_ACCENT);

  printCentered(160, 108, code, 4, COL_ACCENT);

  printCentered(160, 168, String("Code valid for 10 minutes"), 1, COL_FAINT);

  setPairStatus("Waiting for you to link...");

  pairCode   = code;
  lastMsgKey = "";
}


void goPairing() {

  resetReadings();

  linkedUser     = "";
  pairCode       = "";
  lastMsgKey     = "";
  lastLinkPoll   = 0;
  linkingSince   = millis();

  scanBtnState   = BTN_IDLE;
  scanBtnResetAt = 0;

  appState       = APP_LINKING;

  Serial.println("[LINK] Waiting for a website user to link this device");
}


void enterReady(const String &user) {

  linkedUser = user;
  rememberOwner(user);          // [OFFLINE ADDED] so offline mode knows who this device belongs to
  serverFailCount = 0;

  Serial.print("[LINK] Linked to: ");
  Serial.println(user);

  String shown = user.substring(0, 24);

  showMessage("Linked!", "Signed in as " + shown, "Press Scan now to start");

  delay(1800);

  lastMsgKey     = "";
  pairCode       = "";
  scanBtnState   = BTN_IDLE;
  scanBtnResetAt = 0;
  appState       = APP_READY;
  currentScreen  = 0;

  drawScreen();
}


// Hold the logo for 1.5 s: release the device so someone else can link it
void switchUser() {

  Serial.println("[LINK] Switch user requested");

  if (WiFi.status() != WL_CONNECTED) {
    setScanBtn(BTN_NO_WIFI, 2500);
    return;
  }

  setScanBtn(BTN_SENDING, 0);

  String reply;

  int code = httpPost(apiUrl("/api/device/unlink"), "{}", reply, 15000);

  if (code == 200) {
    forgetOwner();
    goPairing();
  }
  else {
    setScanBtn(BTN_FAILED, 2500);
  }
}


// Runs from loop() while the device is not linked yet
void pairingTick() {

  // 0) [OFFLINE ADDED] no Wi-Fi / no internet for a while -> "Continue offline?"

  if (offlinePromptTick(WiFi.status() == WL_CONNECTED)) return;

  // 1) Wi-Fi

  if (WiFi.status() != WL_CONNECTED) {

    String hint = (millis() - linkingSince > 20000)
                    ? "Check name / password (2.4 GHz)"
                    : "Please wait...";

    showMessage("Connecting to Wi-Fi", String(WIFI_SSID), hint);

    return;
  }

  // 2) Device secret

  if (deviceToken.length() != 32) loadOrCreateToken();

  // 3) Ask the website for the current link code (or whether we are linked)

  if (lastLinkPoll != 0 && millis() - lastLinkPoll < LINK_POLL_MS) return;

  if (pairCode.length() == 0) {
    showMessage("Contacting server", "Getting your link code...", "");
  }

  String reply;

  int code = httpPost(apiUrl("/api/device/pair"), "{}", reply, 15000);

  lastLinkPoll = millis();

  if (code == 200) {

    serverFailCount = 0;

    if (jsonGet(reply, "paired") == "true") {
      enterReady(jsonGet(reply, "owner"));
      return;
    }

    String c = jsonGet(reply, "code");

    if (c.length() == 6) {

      if (c != pairCode) {
        Serial.print("[LINK] Link code: ");
        Serial.println(c);
        drawPairingScreen(c);
      }
      else {
        setPairStatus("Waiting for you to link...");
      }
    }
    else {
      Serial.println("[LINK] Unexpected server reply:");
      Serial.println(reply);
    }
  }
  else {

    if (code <= 0) serverFailCount++;     // [OFFLINE ADDED] counts "cannot reach server"

    Serial.print("[LINK] Server problem, HTTP ");
    Serial.println(code);
    Serial.println(reply);

    if (pairCode.length() > 0) {
      setPairStatus(code > 0 ? "Server error " + String(code) : String("No server reply"));
    }
    else {
      showMessage(
        code > 0 ? "Server error " + String(code) : String("Cannot reach server"),
        "Check SERVER_URL in the sketch",
        "Retrying..."
      );
    }
  }
}


// Runs from loop() once linked: returns the button to "Scan now" after feedback
void scanButtonTick() {

  if (scanBtnResetAt != 0 && millis() > scanBtnResetAt) {

    scanBtnResetAt = 0;

    setScanBtn(BTN_IDLE, 0);
  }
}



// ============================================================
// [LCD FIX] LCD WATCHDOG + BOOT DIAGNOSTICS
// ============================================================

// ILI9341 registers that can be READ back (needs the MISO wire, GPIO 13)
#define LCD_REG_RDMODE   0x0A   // display power mode: 0x9C = on and healthy
#define LCD_REG_RDMADCTL 0x0B   // orientation (changes after setRotation)

bool          lcdWatchdogOn = false;
uint8_t       lcdExpectPM   = 0;
uint8_t       lcdExpectMAD  = 0;
uint8_t       lcdBadChecks  = 0;
unsigned long lcdLastCheck  = 0;
unsigned long lcdLastFix    = 0;
unsigned int  lcdFixCount   = 0;
bool          bootDiagShown = false;


// Redraw whatever screen should currently be visible
void lcdRedrawCurrent() {

  if (appState == APP_LINKING) {

    if (offlinePromptOn) {
      drawOfflinePrompt();
    }
    else if (pairCode.length() > 0) {

      String c = pairCode;           // copy: drawPairingScreen() overwrites pairCode

      drawPairingScreen(c);
    }
    else if (lastMsgKey.length() > 0) {

      String a = msgL1;
      String b = msgL2;
      String c = msgL3;

      lastMsgKey = "";               // force showMessage() to really redraw

      showMessage(a, b, c);
    }
    else {

      tft.fillScreen(COL_BG);
    }
  }
  else {

    drawScreen();
  }
}


// Learn what a healthy panel reports. Only arms itself if the reading is
// exactly the normal value AND is stable - so a missing/floating MISO wire
// can never cause false alarms (the watchdog simply stays off).
void lcdArmWatchdog() {

  lcdWatchdogOn = false;

  uint8_t pm  = tft.readcommand8(LCD_REG_RDMODE);
  uint8_t mad = tft.readcommand8(LCD_REG_RDMADCTL);

  bool stable = (pm == 0x9C);

  for (int i = 0; i < 3; i++) {

    delay(5);

    if (
      tft.readcommand8(LCD_REG_RDMODE)   != pm ||
      tft.readcommand8(LCD_REG_RDMADCTL) != mad
    ) {
      stable = false;
    }
  }

  Serial.print("[LCD] power mode 0x");
  Serial.print(pm, HEX);
  Serial.print("  madctl 0x");
  Serial.println(mad, HEX);

  if (stable) {

    lcdExpectPM   = pm;
    lcdExpectMAD  = mad;
    lcdWatchdogOn = true;

    Serial.println("[LCD] watchdog ARMED");
  }
  else {

    Serial.println("[LCD] watchdog OFF (cannot read the panel back - check the SDO/MISO wire)");
  }
}


// Called from loop(): every 1.5 s ask the panel how it is doing.
// If it lost its settings twice in a row, re-initialise it and redraw.
void lcdWatchdogTick() {

  if (!lcdWatchdogOn) return;

  if (millis() - lcdLastCheck < 1500) return;

  lcdLastCheck = millis();

  uint8_t pm  = tft.readcommand8(LCD_REG_RDMODE);
  uint8_t mad = tft.readcommand8(LCD_REG_RDMADCTL);

  if (pm == lcdExpectPM && mad == lcdExpectMAD) {

    lcdBadChecks = 0;

    return;
  }

  lcdBadChecks++;

  if (lcdBadChecks < 2) return;          // one odd reading is not enough

  lcdBadChecks = 0;

  if (millis() - lcdLastFix < 4000) return;   // never thrash

  lcdLastFix = millis();

  lcdFixCount++;

  Serial.print("[LCD] Panel lost its settings (power mode 0x");
  Serial.print(pm, HEX);
  Serial.print(", madctl 0x");
  Serial.print(mad, HEX);
  Serial.print(") - re-initialising. Count: ");
  Serial.println(lcdFixCount);

  tft.begin(TFT_SPI_HZ);

  tft.setRotation(1);

  tft.fillScreen(COL_BG);

  lcdRedrawCurrent();
}


// Plain-language reason for the last restart
void printResetReason() {

  Serial.print("[BOOT] Last restart reason: ");

  switch (esp_reset_reason()) {

    case ESP_RST_POWERON:   Serial.println("power switched on (normal)"); break;
    case ESP_RST_EXT:       Serial.println("reset button / EN pin"); break;
    case ESP_RST_SW:        Serial.println("software restart"); break;
    case ESP_RST_PANIC:     Serial.println("CRASH (exception) - send me the lines printed just before this"); break;
    case ESP_RST_INT_WDT:   Serial.println("interrupt watchdog (program hung)"); break;
    case ESP_RST_TASK_WDT:  Serial.println("task watchdog (program hung)"); break;
    case ESP_RST_WDT:       Serial.println("watchdog (program hung)"); break;
    case ESP_RST_BROWNOUT:  Serial.println("BROWNOUT - the 3.3 V supply dipped. Fix the power (see notes)"); break;
    case ESP_RST_DEEPSLEEP: Serial.println("deep sleep wake"); break;
    default:                Serial.println("other / unknown"); break;
  }
}


// USB serial often attaches after the board boots, so print the facts
// again a few seconds later where you can actually see them.
void bootDiagTick() {

  if (bootDiagShown || millis() < 5000) return;

  bootDiagShown = true;

  printResetReason();

  Serial.print("[BOOT] Free memory: ");
  Serial.print(ESP.getFreeHeap());
  Serial.println(" bytes");

  Serial.print("[LCD] watchdog: ");
  Serial.print(lcdWatchdogOn ? "armed" : "off");
  Serial.print(", repairs so far: ");
  Serial.print(lcdFixCount);
  Serial.print(", panel power-mode reads 0x");
  Serial.print(tft.readcommand8(LCD_REG_RDMODE), HEX);
  Serial.println("  (0x9C = healthy)");
}


// ============================================================
// SETUP
// ============================================================

void setup() {

  Serial.begin(
    115200
  );

  printResetReason();         // [LCD FIX] why did the board (re)start?

  offlineLoad();              // [OFFLINE ADDED] saved scans + last owner from flash


  delay(500);


  // TFT BACKLIGHT

  pinMode(
    TFT_LED,
    OUTPUT
  );

  digitalWrite(
    TFT_LED,
    HIGH
  );


  // SPI

  SPI.begin(
    TFT_SCK,
    TFT_MISO,
    TFT_MOSI,
    TFT_CS
  );


  // TFT

  tft.begin(TFT_SPI_HZ);      // [LCD FIX] slower, more reliable SPI clock

  tft.setRotation(
    1
  );

  tft.fillScreen(
    COL_BG
  );


  // BOOT

  drawBootScreen();


  // RS485

  Serial2.begin(
    4800,
    SERIAL_8N1,
    RX2_PIN,
    TX2_PIN
  );


  pinMode(
    RE_DE_PIN,
    OUTPUT
  );

  digitalWrite(
    RE_DE_PIN,
    LOW
  );


  // TOUCH

  initTouch();


  delay(1500);


  // [LCD FIX] Wi-Fi now starts AFTER the screen is up and stable, and the
  // LCD watchdog is armed first so it knows what a healthy panel looks like.

  lcdArmWatchdog();


  // [WIFI ADDED] start Wi-Fi (non-blocking)

  wifiBegin();


  // INITIAL VALUES

  fertilityScore = 0;

  fertilityGrade = 'D';

  recommendedCrop =
    "Waiting";

  cropTier =
    "Waiting";


  // [LINK ADDED] main screens stay hidden until a website user links the device.
  // The code screen is drawn from loop().

  goPairing();


  // SERIAL

  Serial.println();
  Serial.println(
    "================================"
  );

  Serial.println(
    "SOILSENSE AGRI SENSE"
  );

  Serial.println(
    "7-IN-1 NPK SOIL MONITOR"
  );

  Serial.println(
    "TFT + FT6336 TOUCH"
  );

  Serial.println(
    "LANDSCAPE 320x240"
  );

  Serial.println(
    "PARTIAL SCREEN UPDATE ENABLED"
  );

  Serial.println(
    "================================"
  );
}


// ============================================================
// LOOP
// ============================================================

void loop() {

  // Keeps Wi-Fi alive in every state (non-blocking)

  wifiWatch();


  // [LCD FIX] detect a reset / glitched panel and repair it

  lcdWatchdogTick();

  bootDiagTick();


  // ----------------------------------------------------------
  // [LINK ADDED] NOT LINKED YET: only the code screen runs
  // ----------------------------------------------------------

  if (appState == APP_LINKING) {

    pairingTick();

    delay(20);

    return;
  }


  // ----------------------------------------------------------
  // TOUCH  (navigation + "Scan now" + long-press logo)
  // ----------------------------------------------------------

  handleTouch();


  // ----------------------------------------------------------
  // SENSOR
  // [SCAN CHANGED] The sensor is no longer read every 3 s.
  // It is read once each time "Scan now" is pressed (doScan()).
  // ----------------------------------------------------------

  scanButtonTick();


  // [OFFLINE ADDED] header "OFF" tag follows the Wi-Fi state, saved scans upload by themselves

  static bool lastWifiShown = true;
  bool wifiNow = (WiFi.status() == WL_CONNECTED);
  if (wifiNow != lastWifiShown) {
    lastWifiShown = wifiNow;
    drawHeader();
  }

  offlineSyncTick();


  delay(20);
}
